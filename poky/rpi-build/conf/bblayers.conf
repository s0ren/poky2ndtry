## poky/rpi-build/conf/bblayers.conf
```bitbake
# POKY_BBLAYERS_CONF_VERSION is increased each time build/conf/bblayers.conf
# changes incompatibly
POKY_BBLAYERS_CONF_VERSION = "2"

BBPATH = "${TOPDIR}"
BBFILES ?= ""

POKY_HOME = "/home/soren/Documents/TEC/foolaround/poky2ndtry/poky"

BBLAYERS ?= " \
  ${POKY_HOME}/meta \
  ${POKY_HOME}/meta-poky \
  ${POKY_HOME}/meta-yocto-bsp \
  ${POKY_HOME}/meta-raspberrypi \
  "
```
